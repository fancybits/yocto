## build/conf/bblayers.conf
```bitbake
# POKY_BBLAYERS_CONF_VERSION is increased each time build/conf/bblayers.conf
# changes incompatibly
POKY_BBLAYERS_CONF_VERSION = "2"

BBPATH = "${TOPDIR}"
BBFILES ?= ""

BBLAYERS ?= " \
  /vagrant/poky/meta \
  /vagrant/poky/meta-poky \
  /vagrant/poky/meta-yocto-bsp \
  /vagrant/meta-openembedded/meta-oe \
  /vagrant/meta-openembedded/meta-python \
  /vagrant/meta-openembedded/meta-networking \
  /vagrant/meta-rockchip \
  /vagrant/meta-local \
  "
```

## meta-local/conf/layer.conf
```bitbake
# We have a conf and classes directory, add to BBPATH
BBPATH .= ":${LAYERDIR}"

# We have recipes-* directories, add to BBFILES
BBFILES += "${LAYERDIR}/recipes-*/*/*.bb \
            ${LAYERDIR}/recipes-*/*/*.bbappend"

BBFILE_COLLECTIONS += "meta-local"
BBFILE_PATTERN_meta-local = "^${LAYERDIR}/"
BBFILE_PRIORITY_meta-local = "9"

LAYERDEPENDS_meta-local = "rockchip"
LAYERSERIES_COMPAT_meta-local = "kirkstone"
```

## meta-local/conf/machine/rk3566-t95plus.conf
```bitbake
#@TYPE: Machine
#@NAME: T95PLUS

require conf/machine/include/rk356x.inc

#PREFERRED_PROVIDER_virtual/kernel := "linux-rockchip"
#PREFERRED_VERSION_linux-rockchip := "4.19%"
#LINUXLIBCVERSION := "4.19-custom%"
#KBRANCH = "kernel-4.19"            # 4.19.232
#KBRANCH = "kernel-4.19-2021_05_18" # 4.19.172

PREFERRED_VERSION_linux-rockchip := "5.10%"
LINUXLIBCVERSION := "5.10-custom%"
KBRANCH = "develop-5.10"
#KBRANCH = "kernel-5.10-2022_01_10"

#PREFERRED_VERSION_linux-rockchip := "6.1%"
#PREFERRED_VERSION_linux-yocto := "6.1%"
#PREFERRED_PROVIDER_virtual/kernel := "linux-yocto"
#KBRANCH := "v6.1/standard/base"

COMPATIBLE_MACHINE:rk3566-t95plus = "rk3566-t95plus"

KERNEL_DEVICETREE += "rockchip/t95plus.dtb"
#KERNEL_DEVICETREE += "rockchip/rk3566-t95plus.dtb"

KBUILD_DEFCONFIG = "t95plus_defconfig"

UBOOT_MACHINE = "rk3566_defconfig"

RK_WIFIBT_FIRMWARES = " \
	rkwifibt-firmware \
	brcm-tools \
"

MACHINE_EXTRA_RRECOMMENDS:append = " \
	drm-cursor \
"
```

## meta-local/recipes-bsp/u-boot/files/rk3566_defconfig
```kconfig
CONFIG_BASE_DEFCONFIG="rk3568_defconfig"

CONFIG_LOADER_INI="RK3566MINIALL.ini"

CONFIG_UBOOT_NUM=1
CONFIG_UBOOT_SIZE_KB=2048

CONFIG_TRUST_NUM=1
CONFIG_TRUST_SIZE_KB=1024
CONFIG_TRUST_SHA_MODE=2
CONFIG_TRUST_RSA_MODE=2
```
